// SPDX-License-Identifier: (GPL-2.0+ OR MIT)
/*
 * Copyright (c) 2019 BayLibre, SAS.
 * Author: Neil Armstrong <narmstrong@baylibre.com>
 */

#include "meson-g12-common-u-boot.dtsi"

&tflash_vdd {
	gpio = <&gpio_ao GPIOAO_8 GPIO_OPEN_DRAIN>;
};
